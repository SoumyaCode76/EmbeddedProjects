## CMakeLists.txt
```
#1. Declare minimum CMake version required to build this project
cmake_minimum_required(VERSION 3.20.0)
#2. Locate Zephyr build system as a CMake module
find_package(Zephyr REQUIRED HINTS $ENV{ZEPHYR_BASE})
#3. Name your project
project(blinky)
#4. Tell Zephyr which source files to use
target_sources(app PRIVATE src/main.c)
```

## prj.conf
```kconfig
CONFIG_GPIO=y

# Debug Configuration
CONFIG_DEBUG=y
CONFIG_DEBUG_OPTIMIZATIONS=y
CONFIG_SYMTAB=y

# Console for debug output
CONFIG_CONSOLE=y
CONFIG_UART_CONSOLE=y
CONFIG_SERIAL=y
CONFIG_PRINTK=y

# Optional: Enable debug thread info
CONFIG_DEBUG_THREAD_INFO=y
CONFIG_THREAD_MONITOR=y
CONFIG_THREAD_NAME=y
```

## app.overlay
```dts
&usart1 {
    current-speed = <9600>;
};
&red_led_4 {
    gpios = <&gpiog 14 GPIO_ACTIVE_LOW>;
};
/ {
    aliases {
        led1 = &red_led_4;
    };
};
```

## src/main.c
```c
/* Pull in zephyr kernel facilities, e.g. k_sleep() */
#include <zephyr/kernel.h>
/* Include Zephyr's device model types and helpers */
#include <zephyr/device.h>
/* Access the C macros for reading information from the devicetree */
#include <zephyr/devicetree.h>
/* Bring in the GPIO driver API and the typed GPIO helpers required */
#include <zephyr/drivers/gpio.h>
#include <zephyr/sys/printk.h>

/* The devicetree node identifier for the "led0" alias. */
#define LED0_NODE DT_ALIAS(led0)
#define LED1_NODE DT_ALIAS(led1)

static const struct gpio_dt_spec led_1 = GPIO_DT_SPEC_GET(LED0_NODE, gpios);
static const struct gpio_dt_spec led_2 = GPIO_DT_SPEC_GET(LED1_NODE, gpios);

int main(void)
{
    volatile int ret;

    if (!gpio_is_ready_dt(&led_1)) {
        printk("Error: LED device not ready\n");
        return 0;
    }

    if (!gpio_is_ready_dt(&led_2)) {
        printk("Error: LED device not ready\n");
        return 0;
    }    

    ret = gpio_pin_configure_dt(&led_1, GPIO_OUTPUT_ACTIVE);
    if (ret < 0) {
        printk("Error: Could not configure LED\n");
        return 0;
    }
    ret = gpio_pin_configure_dt(&led_2, GPIO_OUTPUT_ACTIVE);
    if (ret < 0) {
        printk("Error: Could not configure LED\n");
        return 0;
    }    

    printk("Starting blinky on %s\n", CONFIG_BOARD);

    while (1) {
        if (gpio_pin_toggle_dt(&led_1) < 0) {
            printk("Error: Could not toggle LED\n");
            return 0;
        }
        printk("Toggled Green LED\n");
        printk("Green LED status: %d\n", gpio_pin_get_dt(&led_1));        
        k_msleep(1000);
        if (gpio_pin_toggle_dt(&led_2) < 0) {
            printk("Error: Could not toggle LED\n");
            return 0;
        }
        printk("Toggled Red LED\n");
        printk("Red LED status: %d\n", gpio_pin_get_dt(&led_2));
        k_msleep(1000);        
    }
    return 0;
}
```
