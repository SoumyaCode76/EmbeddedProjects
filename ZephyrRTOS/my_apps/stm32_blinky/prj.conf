## CMakeLists.txt
```
# SPDX-License-Identifier: Apache-2.0

cmake_minimum_required(VERSION 3.20.0)

find_package(Zephyr REQUIRED HINTS $ENV{ZEPHYR_BASE})
project(stm32_blinky)

target_sources(app PRIVATE src/main.c)
```

## prj.conf
```kconfig
# Zephyr Project Configuration for STM32 Blinky

# Enable GPIO driver
CONFIG_GPIO=y

# Enable LED support
CONFIG_LED=y

# Enable console for debugging
CONFIG_CONSOLE=y
CONFIG_UART_CONSOLE=y

# Enable serial
CONFIG_SERIAL=y

# Enable printk for debugging
CONFIG_PRINTK=y

# Optimize for size
CONFIG_SIZE_OPTIMIZATIONS=y

# Board specific configurations
CONFIG_BOARD_STM32F429I_DISC1=y
```

## boards/stm32f429i_disc1.overlay
```dts
# STM32F429I Discovery Board Overlay

# Optional: Override LED configuration if needed
&led0 {
    /* Custom LED configuration if required */
};

# Optional: UART configuration for console
&usart1 {
    status = "okay";
    current-speed = <115200>;
};

# Optional: GPIO configuration
&gpiog {
    status = "okay";
};
```

## src/main.c
```c
/*
 * Copyright (c) 2016 Intel Corporation
 *
 * SPDX-License-Identifier: Apache-2.0
 */

#include <zephyr/kernel.h>
#include <zephyr/drivers/gpio.h>

/* The devicetree node identifier for the "led0" alias. */
#define LED0_NODE DT_ALIAS(led0)

/*
 * A build error on this line means your board is unsupported.
 * See the sample documentation for information on how to fix this.
 */
static const struct gpio_dt_spec led = GPIO_DT_SPEC_GET(LED0_NODE, gpios);

int main(void)
{
	int ret;
	bool led_state = true;

	if (!gpio_is_ready_dt(&led)) {
		return 0;
	}

	ret = gpio_pin_configure_dt(&led, GPIO_OUTPUT_ACTIVE);
	if (ret < 0) {
		return 0;
	}

	while (1) {
		ret = gpio_pin_toggle_dt(&led);
		if (ret < 0) {
			return 0;
		}

		led_state = !led_state;
		printf("LED state: %s\n", led_state ? "ON" : "OFF");
		k_msleep(1000);
	}
	return 0;
}
```
